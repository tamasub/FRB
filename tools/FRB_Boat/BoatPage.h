#pragma once
const char BOAT_PAGE[] PROGMEM=R"HTML(<!doctype html>
<html lang="ja"><meta charset="utf-8"><meta name="viewport" content="width=device-width,initial-scale=1">
<title>FRB BOAT</title><style>
*{box-sizing:border-box}body{margin:0;background:#edf4f8;color:#102a3d;font:16px system-ui,sans-serif}main{max-width:480px;margin:auto;padding:18px}h1{margin:0;font-size:29px}small{color:#526b7a}section{background:white;border-radius:18px;padding:18px;margin:14px 0;box-shadow:0 3px 15px #193c5010}button{font:inherit;font-weight:700;min-height:52px;border:0;border-radius:12px;background:#006b83;color:white;padding:10px;cursor:pointer}button:disabled{opacity:.4}button.pressed{background:#efab2c;color:#142c3c}.pad{display:grid;grid-template-columns:1fr 1fr 1fr;gap:10px;margin-top:14px}.pad button{height:76px;touch-action:none;user-select:none;-webkit-user-select:none}.forward{grid-column:2}.back{grid-column:2}.stop{background:#c63643}.wide{width:100%}#status{font-weight:700;margin:14px 0;color:#526b7a}label{display:block;margin:16px 0 6px}input[type=range]{width:100%;accent-color:#006b83;min-height:32px}input[type=number],select{font:inherit;padding:10px;border:1px solid #a8bdc9;border-radius:8px;width:100%}.row{display:flex;gap:12px}.row>*{flex:1}.note{font-size:13px;line-height:1.7;color:#526b7a}details summary{cursor:pointer;font-weight:700}label.check{display:flex;align-items:center;gap:8px}output{float:right;font-weight:700}#outputs{font-variant-numeric:tabular-nums}
</style><main><h1>FRB BOAT <span style="font-size:24px">🚤</span></h1><small>ペットボトル船・スマホ操船</small>
<section><div id="status" role="status">未接続・停止中</div><button id="connect" class="wide">接続して操作を有効にする</button><p id="outputs">左 0% ／ 右 0%</p>
<div class="pad"><button class="forward drive" data-mode="forward" disabled>↑<br>前進</button><button class="drive" data-mode="left" disabled>← 左</button><button class="stop" id="stop">■ 停止</button><button class="drive" data-mode="right" disabled>右 →</button><button class="back drive" data-mode="back" disabled>↓<br>後退</button></div><p class="note">方向ボタンは押している間だけ運転。指を離すと停止します。</p>
<label>速度 <output id="speedValue">40%</output></label><input id="speed" type="range" min="0" max="100" value="40">
<label>旋回の出力差 <output id="turnValue">60%</output></label><input id="turn" type="range" min="0" max="100" value="60"><p class="note">100%なら内側モーターを停止。設定変更は停止してから次の運転に反映します。</p></section>
<section><h2 style="margin:0;font-size:20px">円を描く</h2><div class="row"><div><label for="circle">方向</label><select id="circle"><option value="circleL">左回り</option><option value="circleR">右回り</option></select></div><div><label for="seconds">運転時間（秒）</label><input id="seconds" type="number" min="1" max="300" value="15"></div></div><button id="circleStart" class="wide" style="margin-top:16px" disabled>円運転を開始</button><p class="note">左右の出力差で旋回します。風や水流によって軌跡は変わります。画面を開いたまま使ってください。</p></section>
<section><details><summary>直進・回転方向の調整</summary><label>直進補正 <output id="trimValue">0</output></label><input id="trim" type="range" min="-100" max="100" value="0"><p class="note">＋側はA側（AO1/AO2）を弱め、−側はB側（BO1/BO2）を弱めます。±100で片側が停止。船の左右と逆の場合は、電源を切って左右モーターの出力接続を入れ替えてください。</p><label class="check"><input id="invL" type="checkbox">左モーターの回転を反転</label><label class="check"><input id="invR" type="checkbox">右モーターの回転を反転</label></details></section>
<p class="note">通信切れから約0.8秒で自動停止。再接続しても自動再始動しません。後退の推力はプロペラによって異なります。</p></main>
<script>
const $=id=>document.getElementById(id);
let token=0,seq=0,generation=0,mode='',manual=false,starting=false,beatBusy=false,pointer=null;
function enabled(yes){document.querySelectorAll('.drive').forEach(b=>b.disabled=!yes);$('circleStart').disabled=!yes;}
function show(s){$('status').textContent=s.reason+(s.remaining?' ／ 残り '+s.remaining+' 秒':'');$('outputs').textContent='左 '+s.left+'% ／ 右 '+s.right+'%';}
function clearLocal(){mode='';manual=false;pointer=null;document.querySelectorAll('.pressed').forEach(b=>b.classList.remove('pressed'));}
function lost(){clearLocal();token=0;generation++;enabled(false);$('status').textContent='通信未確認・操作停止。再接続してください';$('outputs').textContent='ESP32側で通信切れ停止';}
async function request(path,params){const controller=new AbortController();const timer=setTimeout(()=>controller.abort(),650);try{const r=await fetch(path,{method:'POST',body:new URLSearchParams(params),signal:controller.signal,cache:'no-store'});if(!r.ok)throw Error('request failed');return await r.json();}finally{clearTimeout(timer);}}
function identity(){return {token,seq:++seq};}
async function stop(){const id=identity(),g=generation;clearLocal();$('status').textContent='停止指示中';if(!token)return;try{const s=await request('/stop',id);if(g===generation)show(s);}catch(e){if(g===generation)lost();}}
$('connect').onclick=async()=>{generation++;const g=generation;clearLocal();token=0;enabled(false);$('connect').disabled=true;try{const s=await request('/session',{});if(g!==generation)return;token=s.token;seq=0;enabled(true);$('status').textContent='接続・停止中';$('outputs').textContent='左 0% ／ 右 0%';}catch(e){if(g===generation)lost();}finally{$('connect').disabled=false;}};
async function start(next,isManual){if(!token || mode || starting)return;mode=next;manual=isManual;starting=true;const id=identity(),g=generation;const p={...id,mode:next,speed:$('speed').value,trim:$('trim').value,turn:$('turn').value,seconds:$('seconds').value,invL:$('invL').checked?1:0,invR:$('invR').checked?1:0};try{const s=await request('/drive',p);if(g===generation && id.seq===seq)show(s);}catch(e){if(g===generation && id.seq===seq)lost();}finally{starting=false;}}
document.querySelectorAll('.drive').forEach(b=>{b.onpointerdown=e=>{e.preventDefault();if(mode||starting||!token)return;pointer=e.pointerId;b.setPointerCapture(e.pointerId);b.classList.add('pressed');start(b.dataset.mode,true);};b.onlostpointercapture=e=>{if(manual && e.pointerId===pointer)stop();};b.oncontextmenu=e=>e.preventDefault();});
function release(e){if(manual && (e.pointerId===pointer || e.type==='blur'))stop();}
window.addEventListener('pointerup',release);window.addEventListener('pointercancel',release);window.addEventListener('blur',()=>{if(mode)stop();});
document.addEventListener('visibilitychange',()=>{if(document.hidden)stop();});
window.addEventListener('pagehide',()=>{if(token)navigator.sendBeacon('/stop',new URLSearchParams(identity()));});
$('stop').onclick=stop;$('circleStart').onclick=()=>{const n=Number($('seconds').value);if(!Number.isInteger(n)||n<1||n>300){$('status').textContent='運転時間は1〜300秒で入力してください';return;}start($('circle').value,false);};
for(const id of ['speed','turn','trim']){$(id).oninput=()=>{$(id+'Value').textContent=$(id).value+(id==='trim'?'':'%');if(mode)stop();};}
for(const id of ['invL','invR','circle','seconds'])$(id).onchange=()=>{if(mode)stop();};
setInterval(async()=>{if(!token || starting || beatBusy || document.hidden)return;beatBusy=true;const id=identity(),g=generation;try{const s=await request('/beat',id);if(g!==generation || id.seq!==seq)return;if(!s.valid){lost();return;}show(s);if(!s.active)clearLocal();}catch(e){if(g===generation && id.seq===seq)lost();}finally{beatBusy=false;}},200);
</script></html>)HTML";
